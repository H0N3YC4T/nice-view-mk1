## boards/shields/nice_view_mk1/Kconfig.defconfig
```kconfig
if SHIELD_NICE_VIEW_MK1

# Event-driven screen: 100ms tick (vs ZMK's 10ms) cuts idle wakeups 10x
config ZMK_DISPLAY_TICK_PERIOD_MS
    default 33 if NICE_VIEW_ANIMATION
    default 100

config LV_Z_VDB_SIZE
    default 100

config LV_DPI_DEF
    default 161

config LV_Z_BITS_PER_PIXEL
    default 1

choice LV_COLOR_DEPTH
    default LV_COLOR_DEPTH_1
endchoice

choice ZMK_DISPLAY_WORK_QUEUE
    default ZMK_DISPLAY_WORK_QUEUE_DEDICATED
endchoice

choice ZMK_DISPLAY_STATUS_SCREEN
    default ZMK_DISPLAY_STATUS_SCREEN_CUSTOM
endchoice

config LV_Z_MEM_POOL_SIZE
    default 8192 if ZMK_DISPLAY_STATUS_SCREEN_CUSTOM

config ZMK_DISPLAY_STATUS_SCREEN_CUSTOM
    imply NICE_VIEW_WIDGET_STATUS

config NICE_VIEW_MK1_WPM_FIXED_RANGE
    bool "Enable fixed range for WPM gauge/chart"
    default y

config NICE_VIEW_MK1_WPM_FIXED_RANGE_MAX
    int "Fixed range maximum for WPM gauge/chart"
    default 100

# default n = single static frame (battery)
config NICE_VIEW_ANIMATION
    bool "Animate the peripheral artwork (vs. a single static frame)"
    default n

# y = only transmutation's bitmaps compiled + theme locked (slim flash)
config NICE_VIEW_MK1_TRANSMUTATION_ONLY
    bool "Compile only the transmutation theme (slim the peripheral build)"
    default y

choice NICE_VIEW_ANIMATION_THEME
    prompt "Default peripheral animation theme"
    default NICE_VIEW_ANIMATION_THEME_TRANSMUTATION
config NICE_VIEW_ANIMATION_THEME_CRYSTAL
    bool "Crystal"
config NICE_VIEW_ANIMATION_THEME_LANDSCAPE
    bool "Landscape (dunes / pyramids / mountains)"
config NICE_VIEW_ANIMATION_THEME_EVANGELION
    bool "Evangelion (spaceships / eva units)"
config NICE_VIEW_ANIMATION_THEME_TRANSMUTATION
    bool "Transmutation"
config NICE_VIEW_ANIMATION_THEME_OMNISSIAH
    bool "Omnissiah"
config NICE_VIEW_ANIMATION_THEME_ULTRAMAR
    bool "Ultramar"
endchoice

config NICE_VIEW_WIDGET_STATUS
    select LV_USE_LABEL
    select LV_USE_IMAGE
    select LV_USE_CANVAS
    # animimg + the anim engine are only referenced by the animated branch, so a
    # static-frame build (NICE_VIEW_ANIMATION=n, the peripheral default) drops them
    select LV_USE_ANIMIMG if NICE_VIEW_ANIMATION
    select LV_USE_ANIMATION if NICE_VIEW_ANIMATION

config NICE_VIEW_WIDGET_INVERTED
    bool "Invert display colors"

if !ZMK_SPLIT || ZMK_SPLIT_ROLE_CENTRAL

config NICE_VIEW_WIDGET_STATUS
    select ZMK_WPM

endif # !ZMK_SPLIT || ZMK_SPLIT_ROLE_CENTRAL

endif # SHIELD_NICE_VIEW_MK1
```
